## board/digi/ccimx6sbc/Kconfig
```kconfig
if TARGET_CCIMX6QSBC || TARGET_CCIMX6DLSBC || TARGET_CCIMX6QPSBC

config SYS_BOARD
	default "ccimx6sbc"

config SYS_VENDOR
	default "digi"

config SYS_SOC
	default "mx6"

config SYS_CONFIG_NAME
	string
	default "ccimx6sbc"

config CCIMX6SBC_GEMMI
	bool "GEMMI carrier board"
	depends on TARGET_CCIMX6QPSBC
	help
	  Customizations for the GEMMI carrier board, based on the
	  ConnectCore 6 Plus SBC: board GPIO init (on-hold, ECP5 camera
	  bridge, I2C3 bus recovery, power LEDs), boot environment and
	  disabled spurious wake-up detection.

source "board/digi/common/Kconfig"

endif
```
